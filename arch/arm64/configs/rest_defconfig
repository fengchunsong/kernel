## arch/arm64/configs/rzxj_defconfig
```kconfig
CONFIG_NO_HZ=y
CONFIG_IRQ_TIME_ACCOUNTING=y
CONFIG_LOG_BUF_SHIFT=18
CONFIG_SLAB_FREELIST_RANDOM=y
CONFIG_KPROBES=y
CONFIG_AIX_PARTITION=y
CONFIG_OSF_PARTITION=y
CONFIG_AMIGA_PARTITION=y
CONFIG_MAC_PARTITION=y
CONFIG_BSD_DISKLABEL=y
CONFIG_MINIX_SUBPARTITION=y
CONFIG_SOLARIS_X86_PARTITION=y
CONFIG_UNIXWARE_DISKLABEL=y
CONFIG_LDM_PARTITION=y
CONFIG_SGI_PARTITION=y
CONFIG_SUN_PARTITION=y
CONFIG_KARMA_PARTITION=y
# CONFIG_IOSCHED_DEADLINE is not set
CONFIG_ARCH_BCM2835=y
CONFIG_PCIE_ECRC=y
CONFIG_PCIEAER_INJECT=m
CONFIG_PCIE_DPC=y
CONFIG_PCIE_PTM=y
CONFIG_PCI_STUB=y
CONFIG_PCIE_QCOM=y
CONFIG_PCI_HOST_THUNDER_PEM=y
CONFIG_PCI_HOST_THUNDER_ECAM=y
CONFIG_PCIE_ARMADA_8K=y
CONFIG_PCIE_ROCKCHIP=y
CONFIG_ARM64_64K_PAGES=y
CONFIG_SCHED_SMT=y
CONFIG_NR_CPUS=4096
CONFIG_NODES_SHIFT=9
CONFIG_HZ_1000=y
CONFIG_CMA_DEBUGFS=y
CONFIG_ZBUD=y
CONFIG_Z3FOLD=y
CONFIG_ZSMALLOC=y
CONFIG_PARAVIRT_TIME_ACCOUNTING=y
CONFIG_ARM64_LSE_ATOMICS=y
CONFIG_CMDLINE="console=ttyAMA0"
# CONFIG_CORE_DUMP_DEFAULT_ELF_HEADERS is not set
CONFIG_HIBERNATION=y
CONFIG_CPU_FREQ_STAT=y
CONFIG_CPU_FREQ_STAT_DETAILS=y
CONFIG_CPU_FREQ_DEFAULT_GOV_ONDEMAND=y
CONFIG_CPU_FREQ_GOV_POWERSAVE=y
CONFIG_CPU_FREQ_GOV_USERSPACE=y
CONFIG_CPU_FREQ_GOV_CONSERVATIVE=y
CONFIG_CPU_FREQ_GOV_SCHEDUTIL=y
CONFIG_ARM_BIG_LITTLE_CPUFREQ=y
# CONFIG_ARM_TEGRA20_CPUFREQ is not set
CONFIG_ACPI_CPPC_CPUFREQ=y
CONFIG_XFRM_USER=y
CONFIG_NET_KEY_MIGRATE=y
CONFIG_IP_PNP_BOOTP=y
CONFIG_IP_MROUTE_MULTIPLE_TABLES=y
CONFIG_INET_DIAG_DESTROY=y
CONFIG_TCP_CONG_ADVANCED=y
CONFIG_TCP_CONG_HSTCP=m
CONFIG_TCP_CONG_HYBLA=m
CONFIG_TCP_CONG_NV=m
CONFIG_TCP_CONG_SCALABLE=m
CONFIG_TCP_CONG_LP=m
CONFIG_TCP_CONG_VENO=m
CONFIG_TCP_CONG_YEAH=m
CONFIG_TCP_CONG_ILLINOIS=m
CONFIG_TCP_CONG_DCTCP=m
CONFIG_TCP_CONG_CDG=m
CONFIG_TCP_CONG_BBR=m
CONFIG_IPV6=m
CONFIG_NETLABEL=y
CONFIG_NETWORK_PHY_TIMESTAMPING=y
CONFIG_NFT_NUMGEN=m
CONFIG_NFT_SET_RBTREE=m
CONFIG_NFT_SET_HASH=m
CONFIG_NFT_QUOTA=m
CONFIG_NFT_DUP_NETDEV=m
CONFIG_NFT_FWD_NETDEV=m
CONFIG_IP_NF_IPTABLES=y
CONFIG_IP_NF_FILTER=y
CONFIG_IP_NF_TARGET_REJECT=y
CONFIG_IP_NF_SECURITY=m
CONFIG_IP6_NF_SECURITY=m
CONFIG_NET_SCTPPROBE=m
CONFIG_RDS_RDMA=m
CONFIG_BRIDGE=m
CONFIG_NET_DSA=m
CONFIG_6LOWPAN_DEBUGFS=y
CONFIG_6LOWPAN_GHC_EXT_HDR_HOP=m
CONFIG_6LOWPAN_GHC_UDP=m
CONFIG_6LOWPAN_GHC_ICMPV6=m
CONFIG_6LOWPAN_GHC_EXT_HDR_DEST=m
CONFIG_6LOWPAN_GHC_EXT_HDR_FRAG=m
CONFIG_6LOWPAN_GHC_EXT_HDR_ROUTE=m
CONFIG_NET_SCH_FQ_CODEL=y
CONFIG_CLS_U32_PERF=y
CONFIG_NET_CLS_MATCHALL=m
CONFIG_NET_ACT_SKBMOD=m
CONFIG_NET_ACT_IFE=m
CONFIG_NET_ACT_TUNNEL_KEY=m
CONFIG_NET_IFE_SKBMARK=m
CONFIG_NET_IFE_SKBPRIO=m
CONFIG_NET_IFE_SKBTCINDEX=m
CONFIG_NET_CLS_IND=y
CONFIG_BATMAN_ADV_BATMAN_V=y
CONFIG_VIRTIO_VSOCKETS=m
CONFIG_NET_NCSI=y
CONFIG_CAN_IFI_CANFD=m
# CONFIG_BT_HS is not set
# CONFIG_BT_LE is not set
# CONFIG_BT_DEBUGFS is not set
CONFIG_BT_HCIUART_AG6XX=y
CONFIG_BT_HCIUART_MRVL=y
CONFIG_BT_QCOMSMD=m
CONFIG_AF_KCM=m
CONFIG_CFG80211_DEBUGFS=y
CONFIG_RFKILL=m
CONFIG_NET_9P_RDMA=m
CONFIG_NFC_PN533_USB=m
CONFIG_NFC_PN533_I2C=m
CONFIG_NET_DEVLINK=m
CONFIG_CMA_SIZE_MBYTES=64
CONFIG_ARM_CCI5xx_PMU=y
CONFIG_SUNXI_RSB=m
CONFIG_TEGRA_ACONNECT=y
CONFIG_MTD_PHYSMAP_OF=m
CONFIG_MTD_PHYSMAP_OF_VERSATILE=y
CONFIG_BLK_DEV_RAM_SIZE=16384
CONFIG_NVME_RDMA=m
CONFIG_NVME_TARGET=m
CONFIG_NVME_TARGET_LOOP=m
CONFIG_NVME_TARGET_RDMA=m
CONFIG_QCOM_COINCELL=m
CONFIG_SCSI_MVSAS_TASKLET=y
CONFIG_SCSI_MPT3SAS=y
CONFIG_SCSI_SMARTPQI=m
CONFIG_SATA_AHCI_PLATFORM=y
CONFIG_AHCI_CEVA=y
CONFIG_AHCI_MVEBU=m
CONFIG_AHCI_SUNXI=m
CONFIG_AHCI_XGENE=y
CONFIG_AHCI_QORIQ=y
CONFIG_SATA_AHCI_SEATTLE=m
CONFIG_ATA_PIIX=y
CONFIG_PATA_PLATFORM=y
CONFIG_PATA_OF_PLATFORM=y
CONFIG_DM_DEBUG=y
CONFIG_DM_SNAPSHOT=y
CONFIG_DM_THIN_PROVISIONING=m
CONFIG_DM_MIRROR=y
CONFIG_DM_ZERO=y
CONFIG_DM_VERITY_FEC=y
CONFIG_ISCSI_TARGET_CXGB4=m
CONFIG_MACVLAN=m
CONFIG_GTP=m
CONFIG_MACSEC=m
CONFIG_VETH=m
# CONFIG_ATM_DRIVERS is not set
CONFIG_NET_DSA_MV88E6060=m
CONFIG_NET_DSA_BCM_SF2=m
CONFIG_B53_SPI_DRIVER=m
CONFIG_B53_MDIO_DRIVER=m
CONFIG_B53_MMAP_DRIVER=m
CONFIG_B53_SRAB_DRIVER=m
CONFIG_NET_DSA_MV88E6XXX=m
CONFIG_NET_DSA_QCA8K=m
# CONFIG_NET_VENDOR_3COM is not set
# CONFIG_NET_VENDOR_ADAPTEC is not set
CONFIG_AMD_XGBE=y
CONFIG_AMD_XGBE_DCB=y
CONFIG_NET_XGENE=m
CONFIG_ARC_EMAC=m
# CONFIG_NET_VENDOR_BROCADE is not set
# CONFIG_NET_VENDOR_CISCO is not set
# CONFIG_NET_VENDOR_DEC is not set
# CONFIG_BE2NET_HWMON is not set
# CONFIG_NET_VENDOR_EZCHIP is not set
# CONFIG_NET_VENDOR_EXAR is not set
CONFIG_HISI_FEMAC=m
# CONFIG_NET_VENDOR_HP is not set
CONFIG_IGB=m
# CONFIG_NET_VENDOR_I825XX is not set
CONFIG_SKY2=m
# CONFIG_NET_VENDOR_MICROCHIP is not set
CONFIG_NFP_NETVF=m
# CONFIG_NET_VENDOR_QLOGIC is not set
CONFIG_QCOM_EMAC=m
# CONFIG_8139TOO_PIO is not set
# CONFIG_NET_VENDOR_RENESAS is not set
# CONFIG_NET_VENDOR_SAMSUNG is not set
# CONFIG_NET_VENDOR_SEEQ is not set
# CONFIG_STMMAC_PLATFORM is not set
# CONFIG_NET_VENDOR_SUN is not set
# CONFIG_NET_VENDOR_SYNOPSYS is not set
# CONFIG_NET_VENDOR_WIZNET is not set
CONFIG_NET_SB1000=y
CONFIG_MDIO_BITBANG=m
CONFIG_MDIO_HISI_FEMAC=m
CONFIG_INTEL_XWAY_PHY=m
CONFIG_MICROSEMI_PHY=m
CONFIG_XILINX_GMII2RGMII=m
CONFIG_PPP=m
# CONFIG_WLAN_VENDOR_ADMTEK is not set
CONFIG_ATH5K_DEBUG=y
CONFIG_ATH9K_AHB=y
CONFIG_ATH9K_DEBUGFS=y
CONFIG_ATH6KL_DEBUG=y
CONFIG_ATH10K_DEBUGFS=y
# CONFIG_WLAN_VENDOR_ATMEL is not set
# CONFIG_B43LEGACY_DEBUG is not set
# CONFIG_WLAN_VENDOR_CISCO is not set
CONFIG_IWLEGACY_DEBUG=y
CONFIG_IWLEGACY_DEBUGFS=y
CONFIG_IWLWIFI_PCIE_RTPM=y
CONFIG_IWLWIFI_DEBUG=y
CONFIG_IWLWIFI_DEBUGFS=y
CONFIG_HERMES_PRISM=y
CONFIG_PCI_HERMES=m
CONFIG_LIBERTAS_MESH=y
CONFIG_RT2X00_LIB_DEBUGFS=y
CONFIG_WL1251_SPI=m
CONFIG_WL1251_SDIO=m
# CONFIG_INPUT_MOUSEDEV_PSAUX is not set
CONFIG_INPUT_EVDEV=y
CONFIG_TABLET_USB_PEGASUS=m
CONFIG_TOUCHSCREEN_EGALAX_SERIAL=m
CONFIG_TOUCHSCREEN_RM_TS=m
CONFIG_TOUCHSCREEN_SILEAD=m
CONFIG_TOUCHSCREEN_SIS_I2C=m
CONFIG_INPUT_HISI_POWERKEY=m
CONFIG_RMI4_CORE=m
CONFIG_RMI4_I2C=m
CONFIG_RMI4_SPI=m
CONFIG_RMI4_F11=y
CONFIG_RMI4_F12=y
CONFIG_RMI4_F30=y
# CONFIG_SERIO_SERPORT is not set
CONFIG_SERIAL_8250_NR_UARTS=32
CONFIG_SERIAL_8250_RUNTIME_UARTS=32
CONFIG_SERIAL_8250_EXTENDED=y
CONFIG_SERIAL_8250_MANY_PORTS=y
CONFIG_SERIAL_8250_SHARE_IRQ=y
CONFIG_SERIAL_8250_RSA=y
CONFIG_SERIAL_8250_BCM2835AUX=y
CONFIG_SERIAL_8250_RT288X=y
CONFIG_SERIAL_8250_MOXA=m
CONFIG_SERIAL_EARLYCON_ARM_SEMIHOST=y
CONFIG_SERIAL_TEGRA=y
CONFIG_SERIAL_XILINX_PS_UART=y
CONFIG_SERIAL_XILINX_PS_UART_CONSOLE=y
CONFIG_VIRTIO_CONSOLE=m
CONFIG_HW_RANDOM_BCM2835=m
CONFIG_HW_RANDOM_HISI=m
CONFIG_HW_RANDOM_CAVIUM=m
CONFIG_RAW_DRIVER=y
CONFIG_MAX_RAW_DEVS=8192
CONFIG_TCG_TPM=m
CONFIG_I2C_CHARDEV=m
CONFIG_I2C_BCM2835=m
CONFIG_I2C_IMX=y
CONFIG_I2C_MESON=y
CONFIG_I2C_MV64XXX=m
CONFIG_I2C_QUP=m
CONFIG_I2C_THUNDERX=m
CONFIG_I2C_CROS_EC_TUNNEL=y
CONFIG_SPI_BCM2835=m
CONFIG_SPI_BCM2835AUX=m
CONFIG_SPI_MESON_SPIFC=m
CONFIG_SPI_ORION=m
CONFIG_SPI_QUP=m
CONFIG_SPI_S3C64XX=y
CONFIG_SPI_TEGRA114=m
CONFIG_SPI_THUNDERX=m
CONFIG_SPMI=m
CONFIG_DP83640_PHY=m
CONFIG_PINCTRL_MAX77620=y
CONFIG_PINCTRL_MSM8996=y
CONFIG_PINCTRL_QCOM_SPMI_PMIC=m
CONFIG_GPIO_MAX77620=y
CONFIG_W1=m
# CONFIG_W1_SLAVE_DS2408_READBACK is not set
CONFIG_W1_SLAVE_DS2433_CRC=y
CONFIG_W1_SLAVE_DS2780=m
CONFIG_W1_SLAVE_DS2781=m
CONFIG_POWER_RESET_GPIO=y
CONFIG_POWER_RESET_GPIO_RESTART=y
CONFIG_BATTERY_BQ27XXX=y
CONFIG_SENSORS_FTSTEUTATES=m
CONFIG_SENSORS_LTC2990=m
CONFIG_SENSORS_MAX31722=m
CONFIG_SENSORS_LTC3815=m
CONFIG_SENSORS_SHT3x=m
CONFIG_SENSORS_INA3221=m
CONFIG_SENSORS_XGENE=m
CONFIG_ARMADA_THERMAL=m
CONFIG_EXYNOS_THERMAL=y
CONFIG_WATCHDOG_SYSFS=y
CONFIG_WDAT_WDT=m
CONFIG_S3C2410_WATCHDOG=y
CONFIG_SUNXI_WATCHDOG=m
CONFIG_MESON_WATCHDOG=m
CONFIG_BCM2835_WDT=m
CONFIG_MFD_CROS_EC=y
CONFIG_MFD_CROS_EC_I2C=y
CONFIG_MFD_HI655X_PMIC=m
CONFIG_MFD_MAX77620=y
CONFIG_MFD_QCOM_RPM=m
CONFIG_MFD_SPMI_PMIC=m
CONFIG_MFD_SEC_CORE=y
CONFIG_MFD_SUN6I_PRCM=y
CONFIG_MFD_VX855=m
CONFIG_REGULATOR_GPIO=y
CONFIG_REGULATOR_HI655X=m
CONFIG_REGULATOR_MAX77620=y
CONFIG_REGULATOR_QCOM_RPM=m
CONFIG_REGULATOR_QCOM_SMD_RPM=m
CONFIG_REGULATOR_QCOM_SPMI=m
CONFIG_REGULATOR_S2MPS11=y
CONFIG_IR_SUNXI=m
CONFIG_VIDEO_TW686X=m
CONFIG_DRM_DP_AUX_CHARDEV=y
CONFIG_DRM_HDLCD=m
CONFIG_DRM_MALI_DISPLAY=m
CONFIG_DRM_RADEON_USERPTR=y
CONFIG_DRM_AMD_ACP=y
CONFIG_DRM_MGAG200=m
CONFIG_DRM_BOCHS=m
CONFIG_DRM_MSM=m
# CONFIG_DRM_MSM_DSI is not set
CONFIG_DRM_TEGRA_STAGING=y
CONFIG_DRM_PANEL_SIMPLE=m
CONFIG_DRM_PANEL_SAMSUNG_LD9040=m
CONFIG_DRM_PANEL_LG_LG4573=m
CONFIG_DRM_PANEL_PANASONIC_VVX10F034N00=m
CONFIG_DRM_PANEL_SAMSUNG_S6E8AA0=m
CONFIG_DRM_PANEL_SHARP_LQ101R1SX01=m
CONFIG_DRM_PANEL_SHARP_LS043T1LE01=m
CONFIG_DRM_ANALOGIX_ANX78XX=m
CONFIG_DRM_I2C_ADV7511=m
CONFIG_DRM_VC4=m
CONFIG_DRM_HISI_HIBMC=y
CONFIG_DRM_HISI_KIRIN=m
CONFIG_FB_TILEBLITTING=y
CONFIG_FB_EFI=y
CONFIG_FB_VIRTUAL=m
CONFIG_FB_SSD1307=m
CONFIG_SOUND=m
CONFIG_SND=m
CONFIG_SND_PCM_OSS=m
CONFIG_SND_SEQUENCER_OSS=y
CONFIG_SND_VERBOSE_PRINTK=y
CONFIG_SND_DEBUG=y
CONFIG_SND_PCM_XRUN_DEBUG=y
CONFIG_SND_HDA_PREALLOC_SIZE=4096
# CONFIG_SND_SPI is not set
CONFIG_SND_SOC=m
CONFIG_SND_I2S_HI6210_I2S=m
CONFIG_SND_SOC_RCAR=m
CONFIG_HID_ASUS=m
CONFIG_HID_CORSAIR=m
CONFIG_HID_CMEDIA=m
CONFIG_HID_GFRM=m
CONFIG_HID_MAGICMOUSE=y
CONFIG_HID_NTRIG=y
CONFIG_HID_SENSOR_HUB=m
CONFIG_HID_ALPS=m
CONFIG_USB_OTG=y
CONFIG_USB_LEDS_TRIGGER_USBPORT=m
CONFIG_USB_MON=y
CONFIG_USB_XHCI_HCD=y
CONFIG_USB_XHCI_PLATFORM=y
CONFIG_USB_XHCI_MVEBU=m
CONFIG_USB_XHCI_TEGRA=m
CONFIG_USB_EHCI_EXYNOS=y
CONFIG_USB_OHCI_EXYNOS=y
CONFIG_USB_UHCI_HCD=y
CONFIG_USB_RENESAS_USBHS=m
CONFIG_USBIP_VUDC=m
CONFIG_USB_DWC2_PCI=m
CONFIG_USB_SERIAL=y
CONFIG_USB_SERIAL_CONSOLE=y
CONFIG_USB_SERIAL_SAFE_PADDED=y
CONFIG_USB_SISUSBVGA_CON=y
CONFIG_USB_HSIC_USB4604=m
CONFIG_UCSI=m
CONFIG_USB_GADGET_VBUS_DRAW=100
CONFIG_U_SERIAL_CONSOLE=y
CONFIG_USB_RENESAS_USBHS_UDC=m
CONFIG_USB_CONFIGFS_F_TCM=y
CONFIG_UWB_WHCI=m
CONFIG_MMC=m
# CONFIG_PWRSEQ_EMMC is not set
# CONFIG_PWRSEQ_SIMPLE is not set
CONFIG_MMC_ARMMMCI=m
# CONFIG_MMC_QCOM_DML is not set
CONFIG_MMC_SDHCI=m
CONFIG_MMC_SPI=m
CONFIG_MMC_SDHI=m
CONFIG_MMC_DW=m
CONFIG_MMC_DW_K3=m
CONFIG_MMC_SUNXI=m
CONFIG_LEDS_LP3952=m
CONFIG_LEDS_TRIGGER_DISK=y
CONFIG_LEDS_TRIGGER_MTD=y
CONFIG_LEDS_TRIGGER_HEARTBEAT=m
CONFIG_LEDS_TRIGGER_GPIO=m
CONFIG_LEDS_TRIGGER_DEFAULT_ON=m
CONFIG_LEDS_TRIGGER_TRANSIENT=m
CONFIG_LEDS_TRIGGER_CAMERA=m
CONFIG_LEDS_TRIGGER_PANIC=y
CONFIG_ACCESSIBILITY=y
CONFIG_A11Y_BRAILLE_CONSOLE=y
CONFIG_INFINIBAND=m
CONFIG_INFINIBAND_USER_MAD=m
CONFIG_INFINIBAND_USER_ACCESS=m
CONFIG_INFINIBAND_MTHCA=m
CONFIG_INFINIBAND_QIB=m
CONFIG_INFINIBAND_CXGB3=m
CONFIG_INFINIBAND_CXGB4=m
CONFIG_INFINIBAND_I40IW=m
CONFIG_MLX4_INFINIBAND=m
CONFIG_MLX5_INFINIBAND=m
CONFIG_INFINIBAND_NES=m
CONFIG_INFINIBAND_OCRDMA=m
CONFIG_INFINIBAND_HNS=m
CONFIG_INFINIBAND_IPOIB=m
CONFIG_INFINIBAND_IPOIB_CM=y
CONFIG_INFINIBAND_IPOIB_DEBUG_DATA=y
CONFIG_INFINIBAND_SRP=m
CONFIG_INFINIBAND_SRPT=m
CONFIG_INFINIBAND_ISER=m
CONFIG_INFINIBAND_ISERT=m
CONFIG_INFINIBAND_RDMAVT=m
CONFIG_RDMA_RXE=m
CONFIG_EDAC=y
CONFIG_EDAC_MM_EDAC=m
CONFIG_EDAC_XGENE=m
# CONFIG_RTC_SYSTOHC is not set
CONFIG_RTC_DRV_MAX77686=y
CONFIG_RTC_DRV_RX8010=m
CONFIG_RTC_DRV_S5M=y
CONFIG_RTC_DRV_MAX6916=m
CONFIG_RTC_DS1685_SYSFS_REGS=y
CONFIG_RTC_DRV_S3C=y
CONFIG_RTC_DRV_PL031=y
CONFIG_RTC_DRV_SUN6I=m
CONFIG_RTC_DRV_MV=m
CONFIG_RTC_DRV_ARMADA38X=m
CONFIG_RTC_DRV_XGENE=m
CONFIG_DMA_BCM2835=m
CONFIG_MV_XOR=y
CONFIG_TEGRA210_ADMA=y
CONFIG_QCOM_HIDMA_MGMT=y
CONFIG_QCOM_HIDMA=y
CONFIG_VFIO=m
CONFIG_VFIO_NOIOMMU=y
CONFIG_VFIO_PCI=m
CONFIG_VFIO_PLATFORM=m
CONFIG_VFIO_AMBA=m
CONFIG_VFIO_PLATFORM_AMDXGBE_RESET=m
CONFIG_VIRTIO_PCI=m
CONFIG_VIRTIO_BALLOON=m
CONFIG_XEN_GNTDEV=y
CONFIG_XEN_GRANT_DEV_ALLOC=y
CONFIG_RTLLIB=m
CONFIG_RTL8192E=m
CONFIG_R8712U=m
CONFIG_COMMON_CLK_S2MPS11=y
CONFIG_CLK_QORIQ=y
# CONFIG_COMMON_CLK_HI3519 is not set
CONFIG_RESET_HISI=y
CONFIG_MSM_MMCC_8996=y
CONFIG_HWSPINLOCK_QCOM=m
CONFIG_ROCKCHIP_MBOX=y
CONFIG_BCM2835_MBOX=y
CONFIG_XGENE_SLIMPRO_MBOX=m
CONFIG_RASPBERRYPI_POWER=y
CONFIG_QCOM_SMEM=m
CONFIG_QCOM_SMD=m
CONFIG_QCOM_SMD_RPM=m
CONFIG_QCOM_SMP2P=m
CONFIG_QCOM_SMSM=m
CONFIG_QCOM_WCNSS_CTRL=m
CONFIG_IIO=m
CONFIG_IIO_SW_DEVICE=m
CONFIG_IIO_SW_TRIGGER=m
CONFIG_MMA7660=m
CONFIG_EXYNOS_ADC=m
CONFIG_ROCKCHIP_SARADC=m
CONFIG_MAX30100=m
CONFIG_IIO_TIGHTLOOP_TRIGGER=m
CONFIG_BMP280=m
CONFIG_PWM_BCM2835=m
CONFIG_PWM_ROCKCHIP=m
CONFIG_PWM_SAMSUNG=y
CONFIG_PWM_SUN4I=m
CONFIG_PWM_TEGRA=m
CONFIG_COMMON_RESET_HI6220=m
CONFIG_PHY_RCAR_GEN3_USB2=m
CONFIG_PHY_ROCKCHIP_INNO_USB2=m
CONFIG_PHY_ROCKCHIP_EMMC=m
CONFIG_PHY_ROCKCHIP_DP=m
CONFIG_PHY_ROCKCHIP_PCIE=m
CONFIG_PHY_ROCKCHIP_TYPEC=m
CONFIG_PHY_XGENE=y
CONFIG_PHY_TEGRA_XUSB=m
CONFIG_XGENE_PMU=y
CONFIG_LIBNVDIMM=m
CONFIG_QCOM_QFPROM=m
CONFIG_ROCKCHIP_EFUSE=m
CONFIG_NVMEM_SUNXI_SID=m
CONFIG_TEE=m
CONFIG_OPTEE=m
CONFIG_DMI_SYSFS=y
CONFIG_RASPBERRYPI_FIRMWARE=y
CONFIG_FW_CFG_SYSFS=m
CONFIG_EFI_VARS_PSTORE_DEFAULT_DISABLE=y
CONFIG_ACPI_EC_DEBUGFS=y
CONFIG_ACPI_HED=m
CONFIG_ACPI_CUSTOM_METHOD=m
CONFIG_ACPI_CONFIGFS=m
CONFIG_EXT2_FS=y
CONFIG_EXT3_FS=y
CONFIG_REISERFS_PROC_INFO=y
# CONFIG_OCFS2_FS_STATS is not set
# CONFIG_OCFS2_DEBUG_MASKLOG is not set
# CONFIG_MANDATORY_FILE_LOCKING is not set
CONFIG_FANOTIFY_ACCESS_PERMISSIONS=y
CONFIG_QFMT_V2=y
CONFIG_AUTOFS4_FS=y
CONFIG_FSCACHE_OBJECT_LIST=y
CONFIG_FAT_DEFAULT_IOCHARSET="ascii"
CONFIG_PROC_CHILDREN=y
CONFIG_CONFIGFS_FS=y
CONFIG_ORANGEFS_FS=m
CONFIG_AFFS_FS=m
CONFIG_ECRYPT_FS=m
CONFIG_HFS_FS=m
CONFIG_HFSPLUS_FS=m
CONFIG_BEFS_FS=m
CONFIG_UBIFS_ATIME_SUPPORT=y
CONFIG_CRAMFS=m
CONFIG_SQUASHFS_LZ4=y
CONFIG_ROMFS_FS=m
CONFIG_PSTORE_RAM=m
CONFIG_SYSV_FS=m
CONFIG_UFS_FS=m
CONFIG_NFSD_BLOCKLAYOUT=y
CONFIG_NFSD_SCSILAYOUT=y
CONFIG_NFSD_V4_SECURITY_LABEL=y
CONFIG_NCPFS_SMALLDOS=y
CONFIG_9P_FSCACHE=y
CONFIG_NLS_ASCII=y
CONFIG_NLS_ISO8859_1=m
CONFIG_DLM_DEBUG=y
CONFIG_VHOST_VSOCK=m
# CONFIG_ENABLE_WARN_DEPRECATED is not set
CONFIG_FRAME_WARN=1024
CONFIG_STRIP_ASM_SYMS=y
CONFIG_UNUSED_SYMBOLS=y
CONFIG_HEADERS_CHECK=y
CONFIG_DEBUG_SECTION_MISMATCH=y
CONFIG_MAGIC_SYSRQ_DEFAULT_ENABLE=0x0
CONFIG_DEBUG_KERNEL=y
CONFIG_TIMER_STATS=y
CONFIG_SPARSE_RCU_POINTER=y
CONFIG_RCU_TORTURE_TEST=m
CONFIG_RCU_CPU_STALL_TIMEOUT=60
CONFIG_LATENCYTOP=y
# CONFIG_FTRACE is not set
CONFIG_ATOMIC64_SELFTEST=y
CONFIG_TEST_KSTRTOX=y
CONFIG_KGDB_TESTS=y
CONFIG_KDB_DEFAULT_ENABLE=0x0
CONFIG_IO_STRICT_DEVMEM=y
CONFIG_SECURITY=y
CONFIG_CRYPTO_ECHAINIV=y
CONFIG_CRYPTO_ANSI_CPRNG=y
```
